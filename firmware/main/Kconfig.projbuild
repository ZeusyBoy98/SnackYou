## firmware/main/Kconfig.projbuild
```kconfig
menu "SnackYou Configuration"

    config SNACKYOU_WIFI_SSID
        string "WiFi SSID"
        default "myssid"
        help
            SSID (network name) for the firmware to connect to.

    config SNACKYOU_WIFI_PASSWORD
        string "WiFi Password"
        default "mypassword"
        help
            WiFi password (WPA or WPA2) for the firmware to use.

    config SNACKYOU_WIFI_MAXIMUM_RETRY
        int "Maximum WiFi connect retries"
        default 10
        help
            Number of reconnection attempts before giving up and rebooting.

    config SNACKYOU_STREAM_PORT
        int "Camera stream HTTP port"
        default 80
        help
            TCP port the MJPEG camera stream server listens on.

    config SNACKYOU_CAMERA_UPLOAD_ENABLED
        bool "Upload camera frames to SnackYou API"
        default y
        help
            Push JPEG frames to the hosted API so the HTTPS web app can display
            the camera feed without mixed-content browser blocking.

    config SNACKYOU_CAMERA_UPLOAD_URL
        string "Camera frame upload URL"
        default "https://snackapi.zeusyboy.com/api/esp/camera"
        depends on SNACKYOU_CAMERA_UPLOAD_ENABLED
        help
            API endpoint that receives image/jpeg frames from the ESP32.

    config SNACKYOU_CAMERA_UPLOAD_INTERVAL_MS
        int "Camera upload interval (ms)"
        default 150
        depends on SNACKYOU_CAMERA_UPLOAD_ENABLED
        help
            Delay between uploaded frames. 150 ms is about 6-7 FPS before
            network and API overhead.

endmenu
```

## firmware/sdkconfig.defaults
```kconfig
CONFIG_IDF_TARGET="esp32s3"
CONFIG_ESP_CONSOLE_USB_CDC=y
CONFIG_ESP_CONSOLE_SECONDARY_NONE=y

# CPU at 240 MHz and flash at 80 MHz, as recommended by esp32-camera
CONFIG_ESP_DEFAULT_CPU_FREQ_MHZ_240=y
CONFIG_ESPTOOLPY_FLASHFREQ_80M=y

# The XIAO ESP32-S3 Sense has 8 MB of flash
CONFIG_ESPTOOLPY_FLASHSIZE_8MB=y

# HTTPS camera upload exceeds the default 1 MB app slot.
CONFIG_PARTITION_TABLE_CUSTOM=y
CONFIG_PARTITION_TABLE_CUSTOM_FILENAME="partitions.csv"

# PSRAM (8 MB octal on the XIAO ESP32-S3 Sense); the camera driver requires
# PSRAM for anything above CIF JPEG. Keep booting if a board lacks PSRAM so
# the firmware's runtime fallback can take over.
CONFIG_SPIRAM=y
CONFIG_SPIRAM_MODE_OCT=y
CONFIG_SPIRAM_SPEED_80M=y
CONFIG_SPIRAM_IGNORE_NOTFOUND=y

# HTTPS uploads to snackapi.zeusyboy.com
CONFIG_MBEDTLS_CERTIFICATE_BUNDLE=y

# FREERTOS
CONFIG_FREERTOS_HZ=1000
```
